OUTPUT_ARCH("riscv")
ENTRY(_start)

SECTIONS
{
  .text : {
    *(.text .text.*)
  }

  .rodata : {
    *(.rodata .rodata.*)
  }

  .data : {
    *(.data .data.*)
  }

  .bss : {
    *(.bss .bss.*)
  }
}