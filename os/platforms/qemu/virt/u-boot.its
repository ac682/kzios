## os/platforms/qemu/virt/u-boot.its
```
/dts-v1/;

/ {
	description = "eRhino kernel and initfs";
	#address-cells = <2>;

	images {
		uboot {
            description = "U-Boot";
            data = /incbin/("../../../../submodules/u-boot/u-boot-nodtb.bin");
            type = "standalone";
            arch = "riscv";
			os = "u-boot";
            compression = "none";
            load = <0x0 0x81200000>;
            entry = <0x0 0x81200000>;
        };
		opensbi {
			description = "OpenSBI dynamic firmware";
			data = /incbin/("../../../../submodules/opensbi/build/platform/generic/firmware/fw_dynamic.bin");
			type = "firmware";
			arch = "riscv";
			os = "opensbi";
			compression = "none";
            load = <0x0 0x80100000>;
            entry = <0x0 0x80100000>;
		};
		erhino {
			description = "eRhino kernel";
			data = /incbin/("../../../../artifacts/erhino_kernel.bin");
			type = "kernel";
			arch = "riscv";
			os = "linux";
			compression = "none";
			load = <0x0 0x80400000>;
			entry = <0x0 0x80400000>;
		};
		fdt {
			description = "Device tree blob";
			data = /incbin/("../../../../artifacts/device.dtb");
			type = "flat_dt";
		};
	};

	configurations {
		default = "config";
		config {
			description = "Whoa";
			kernel = "erhino";
			loadables = "uboot";
			firmware = "opensbi";
			fdt = "fdt";
		};
	};
};
```
