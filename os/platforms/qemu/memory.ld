MEMORY
{
    FLASH (rx) : ORIGIN = 0x20000000, LENGTH = 64M
    DRAM_SBI (rx) : ORIGIN = 0x80000000, LENGTH = 2M
    DRAM_FREE (rwx) : ORIGIN = 0x80200000, LENGTH = 126M
}

HEAP_SIZE = 0xC000;
STACK_SIZE = 0x4000;
HART_NUM = 4;

REGION_ALIAS("ROM", FLASH);
REGION_ALIAS("SBI", DRAM_SBI);
REGION_ALIAS("RAM", DRAM_FREE);
