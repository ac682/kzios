MEMORY
{
    FLASH (rx) : ORIGIN = 0x20000000, LENGTH = 64M
    DRAM (rwx) : ORIGIN = 0x80000000, LENGTH = 128M
}

HEAP_SIZE = 0xC000;
STACK_SIZE = 0x4000;
HART_NUM = 4;

REGION_ALIAS("ROM", FLASH);
REGION_ALIAS("RAM", DRAM);
